## components/live_peer/Kconfig
```kconfig
menu "Portable WebRTC peer"
    config LIVE_PEER_TRACE_ICE
        bool "Log ICE consent diagnostics"
        default n
        help
            Log consent send results, response validation flags and round-trip
            times. Does not log credentials, transaction IDs or IP addresses.
endmenu
```

## examples/waveshare_round/main/Kconfig.projbuild
```kconfig
menu "Round Waveshare Live Voice"
config LIVE_ROUND_PTT_GPIO
    int "Push-to-talk GPIO (0=BOOT, -1=disabled)"
    range -1 18
    default -1
    help
        Select 0 to use the built-in BOOT button, with the microphone gated
        from startup. Release BOOT before resetting or powering on the board.
        Alternatively, connect a normally-open, passive switch between GPIO16
        and GND, then choose 16. GPIO17/18 are also accepted for non-GPS boards.
        Other pins are rejected at build time to protect board peripherals.
        Use 3.3 V logic only. A two-wire switch is detected on its first
        press, not merely by plugging it in; PTT then stays enabled until
        reboot. Leaving -1 still permits USB talk-press/talk-release tests.
endmenu
```
